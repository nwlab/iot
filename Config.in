## package/python-SpeechRecognition/Config.in
```kconfig
config BR2_PACKAGE_PYTHON_SPEECHRECOGNITION
	bool "python-SpeechRecognition"
    select BR2_PACKAGE_PYTHON_PYAUDIO
    select BR2_PACKAGE_FLAC
	help
      Library for performing speech recognition, with support for several engines and APIs, online and offline.

	  https://github.com/Uberi/speech_recognition
```

## package/python-pocketsphinx/Config.in
```kconfig
config BR2_PACKAGE_PYTHON_POCKETSPHINX
	bool "python-pocketsphinx"
	depends on BR2_PACKAGE_PYTHON3 # python-tempora
	select BR2_PACKAGE_POCKETSPHINX
	select BR2_PACKAGE_SPHINXBASE
	select BR2_PACKAGE_PULSEAUDIO
	help
	  Python interface to CMU Sphinxbase and Pocketsphinx libraries https://pypi.python.org/pypi/pocketsphinx

	  https://github.com/bambocher/pocketsphinx-python
```

## package/python-pydub/Config.in
```kconfig
config BR2_PACKAGE_PYTHON_PYDUB
	bool "python-pydub"
	depends on BR2_PACKAGE_PYTHON3 # python-tempora
	help
	  Manipulate audio with an simple and easy high level interface

	  http://pydub.com/
```

## package/python-pyowm/Config.in
```kconfig
config BR2_PACKAGE_PYTHON_PYOWM
	bool "python-pyowm"
	depends on BR2_PACKAGE_PYTHON3 # python-tempora
	help
	  A Python wrapper around OpenWeatherMap web APIs

	  http://github.com/csparpa/pyowm
```

## package/rhvoice/Config.in
```kconfig
config BR2_PACKAGE_RHVOICE
	bool "RHVoice"
	help
	  RHVoice is a free and open source speech synthesizer for Russian language.

	  https://github.com/Olga-Yakovleva/RHVoice
```

## package/snowboy/Config.in
```kconfig
config BR2_PACKAGE_SNOWBOY
	bool "snowboy"
	depends on BR2_PACKAGE_PYTHON3
    select BR2_PACKAGE_ATLAS
	help
      DNN based hotword and wake word detection toolkit 

      https://snowboy.kitt.ai
```

## package/speech-dispatcher/Config.in
```kconfig
config BR2_PACKAGE_SPEECH_DISPATCHER
	bool "speech-dispatcher"
    select BR2_PACKAGE_LIBDOTCONF
    select BR2_PACKAGE_LIBSNDFILE
	select BR2_PACKAGE_LIBTOOL
	help
	  Common interface to speech synthesis

	  https://github.com/brailcom/speechd

if BR2_PACKAGE_SPEECH_DISPATCHER

comment "modules"

config BR2_PACKAGE_SPEECH_DISPATCHER_ESPEAK
	bool "espeak"
	depends on BR2_PACKAGE_ESPEAK

config BR2_PACKAGE_SPEECH_DISPATCHER_RHVOICE
	bool "RHVoice"
	depends on BR2_PACKAGE_RHVOICE

config BR2_PACKAGE_SPEECH_DISPATCHER_ESPEAK_NG
	bool "espeak-ng"
	depends on BR2_PACKAGE_ESPEAK_NG

config BR2_PACKAGE_SPEECH_DISPATCHER_PICOTTS
	bool "pico"
	depends on BR2_PACKAGE_PICOTTS

config BR2_PACKAGE_SPEECH_DISPATCHER_FESTIVAL
	bool "festival"
	depends on BR2_PACKAGE_FESTIVAL

config BR2_PACKAGE_SPEECH_DISPATCHER_CICERO
	bool "cicero"

endif
```

## package/sphinxbase2/Config.in
```kconfig
config BR2_PACKAGE_SPHINXBASE2
	bool "sphinxbase"
	default y
	help
	  voice recognition library thing.
```

## package/wm8960/Config.in
```kconfig
config BR2_PACKAGE_WM8960
	bool "wm8960"
	depends on BR2_LINUX_KERNEL
	help
	  wm8960 sound driver

	  https://github.com/respeaker/seeed-voicecard

comment "wm8960 needs a Linux kernel to be built"
	depends on !BR2_LINUX_KERNEL
```
