## Config.in
```kconfig
# make the variant name available as a Config.in variable
#
# you can use BR2SM_PROJECT_NAME to have some options only appear for some variants
#
config BR2SM_PROJECT_NAME
	string
	option env="PROJECT_NAME"

	source "../package/analogclock/Config.in"
	source "../package/dashboard/Config.in"
	source "../package/433utils/Config.in"

menu "Genie speach applications"
	source "../package/genie_assistant/Config.in"
	source "../package/festival/Config.in"
	source "../package/pocketsphinx/Config.in"
    source "../package/picotts/Config.in"
    source "../package/mplayer/Config.in"
    source "../package/python-PyAudio/Config.in"
    source "../package/python-SpeechRecognition/Config.in"
    source "../package/python-pydub/Config.in"
    source "../package/python-pyowm/Config.in"
    source "../package/python-pocketsphinx/Config.in"
    source "../package/wm8960/Config.in"
    source "../package/snowboy/Config.in"
    source "../package/speech-dispatcher/Config.in"
    source "../package/libdotconf/Config.in"
    source "../package/espeak-ng/Config.in"
endmenu
```

## dacha/defconfig
```kconfig
BR2_arm=y
BR2_cortex_a7=y
BR2_ARM_FPU_NEON_VFPV4=y
BR2_DL_DIR="$(HOME)/.dl"
BR2_CCACHE=y
BR2_CCACHE_DIR="$(HOME)/.ccache"
BR2_TOOLCHAIN_BUILDROOT_GLIBC=y
BR2_KERNEL_HEADERS_4_14=y
BR2_BINUTILS_VERSION_2_31_X=y
BR2_GCC_VERSION_8_X=y
BR2_TOOLCHAIN_BUILDROOT_CXX=y
BR2_TARGET_GENERIC_HOSTNAME="dacha"
BR2_TARGET_GENERIC_ISSUE="Welcome to DACHA"
BR2_INIT_SYSV=y
BR2_ROOTFS_DEVICE_CREATION_DYNAMIC_EUDEV=y
BR2_TARGET_GENERIC_ROOT_PASSWD="iot"
BR2_SYSTEM_BIN_SH_BASH=y
BR2_SYSTEM_DHCP="eth0"
BR2_TARGET_TZ_INFO=y
BR2_TARGET_LOCALTIME="Europe/Kiev"
BR2_ROOTFS_OVERLAY="${BR2_EXTERNAL}/board/dacha/rootfs_overlay ${BR2_EXTERNAL}/board/dacha/rootfs_overlay_priv"
BR2_ROOTFS_POST_BUILD_SCRIPT="${BR2_EXTERNAL}/board/dacha/post-build.sh"
BR2_ROOTFS_POST_IMAGE_SCRIPT="${BR2_EXTERNAL}/board/dacha/post-image.sh ${BR2_EXTERNAL}/board/dacha/swupdate/build-swu.sh"
BR2_LINUX_KERNEL=y
BR2_LINUX_KERNEL_CUSTOM_GIT=y
BR2_LINUX_KERNEL_CUSTOM_REPO_URL="https://github.com/raspberrypi/linux.git"
BR2_LINUX_KERNEL_CUSTOM_REPO_VERSION="9b15abaf52801fae247a66f6efbf0819da72610d"
BR2_LINUX_KERNEL_DEFCONFIG="bcm2709"
BR2_LINUX_KERNEL_CONFIG_FRAGMENT_FILES="${BR2_EXTERNAL}/board/dacha/linux.config"
BR2_LINUX_KERNEL_DTS_SUPPORT=y
BR2_LINUX_KERNEL_INTREE_DTS_NAME="bcm2709-rpi-2-b bcm2710-rpi-3-b bcm2710-rpi-3-b-plus bcm2710-rpi-cm3"
BR2_PACKAGE_BUSYBOX_CONFIG_FRAGMENT_FILES="${BR2_EXTERNAL}/board/dacha/busybox.config"
BR2_PACKAGE_GETTEXT=y
BR2_PACKAGE_E2FSPROGS=y
BR2_PACKAGE_E2FSPROGS_RESIZE2FS=y
BR2_PACKAGE_MTD=y
BR2_PACKAGE_FBSET=y
BR2_PACKAGE_FBV=y
BR2_PACKAGE_QT5=y
BR2_PACKAGE_QT53D=y
BR2_PACKAGE_QT5BASE_SQLITE_QT=y
BR2_PACKAGE_QT5BASE_LINUXFB=y
BR2_PACKAGE_QT5BASE_EGLFS=y
BR2_PACKAGE_QT5BASE_DEFAULT_QPA="eglfs"
BR2_PACKAGE_QT5BASE_FONTCONFIG=y
BR2_PACKAGE_QT5BASE_GIF=y
BR2_PACKAGE_QT5BASE_JPEG=y
BR2_PACKAGE_QT5BASE_PNG=y
BR2_PACKAGE_QT5BASE_ICU=y
BR2_PACKAGE_QT5BASE_TSLIB=y
BR2_PACKAGE_QT5IMAGEFORMATS=y
BR2_PACKAGE_QT5MULTIMEDIA=y
BR2_PACKAGE_QT5SENSORS=y
BR2_PACKAGE_QT5SERIALBUS=y
BR2_PACKAGE_QT5WEBSOCKETS=y
BR2_PACKAGE_RPI_FIRMWARE=y
BR2_PACKAGE_RPI_FIRMWARE_X=y
BR2_PACKAGE_RPI_FIRMWARE_INSTALL_VCDBG=y
BR2_PACKAGE_RPI_WIFI_FIRMWARE=y
BR2_PACKAGE_I2C_TOOLS=y
BR2_PACKAGE_MINICOM=y
BR2_PACKAGE_RTC_TOOLS=y
BR2_PACKAGE_SPI_TOOLS=y
BR2_PACKAGE_USB_MODESWITCH_DATA=y
BR2_PACKAGE_LUA=y
BR2_PACKAGE_NODEJS=y
BR2_PACKAGE_NODEJS_NPM=y
BR2_PACKAGE_NODEJS_MODULES_ADDITIONAL="node-red"
BR2_PACKAGE_PYTHON=y
BR2_PACKAGE_PYTHON_RPI_GPIO=y
BR2_PACKAGE_SQLITE=y
BR2_PACKAGE_SQLITE_NO_SYNC=y
BR2_PACKAGE_LIBCONFIG=y
BR2_PACKAGE_PIXMAN=y
BR2_PACKAGE_LIBCURL=y
BR2_PACKAGE_LIBEVDEV=y
BR2_PACKAGE_DNSMASQ=y
# BR2_PACKAGE_DNSMASQ_TFTP is not set
BR2_PACKAGE_IPERF3=y
BR2_PACKAGE_IPROUTE2=y
BR2_PACKAGE_IPTABLES=y
BR2_PACKAGE_IW=y
BR2_PACKAGE_MOSQUITTO=y
BR2_PACKAGE_NTP=y
BR2_PACKAGE_OPENSSH=y
BR2_PACKAGE_OPENVPN=y
BR2_PACKAGE_PPPD=y
BR2_PACKAGE_WPA_SUPPLICANT=y
BR2_PACKAGE_WPA_SUPPLICANT_AP_SUPPORT=y
BR2_PACKAGE_WPA_SUPPLICANT_WIFI_DISPLAY=y
BR2_PACKAGE_PROCPS_NG=y
BR2_PACKAGE_SWUPDATE=y
BR2_PACKAGE_SWUPDATE_CONFIG="${BR2_EXTERNAL}/board/dacha/swupdate/swupdate.config"
BR2_PACKAGE_MC=y
BR2_PACKAGE_NANO=y
BR2_PACKAGE_VIM=y
# BR2_PACKAGE_VIM_RUNTIME is not set
BR2_TARGET_ROOTFS_EXT2=y
BR2_TARGET_ROOTFS_EXT2_4=y
BR2_TARGET_ROOTFS_EXT2_SIZE="524288"
BR2_TARGET_ROOTFS_EXT2_MKFS_OPTIONS="-O 64bit"
# BR2_TARGET_ROOTFS_TAR is not set
BR2_PACKAGE_HOST_DOSFSTOOLS=y
BR2_PACKAGE_HOST_GENIMAGE=y
BR2_PACKAGE_HOST_MTOOLS=y
BR2_PACKAGE_ANALOGCLOCK=y
```

## genie/defconfig
```kconfig
BR2_arm=y
BR2_arm1176jzf_s=y
BR2_DL_DIR="$(HOME)/.dl"
BR2_CCACHE=y
BR2_CCACHE_DIR="$(HOME)/.ccache"
BR2_TOOLCHAIN_BUILDROOT_GLIBC=y
BR2_KERNEL_HEADERS_4_19=y
BR2_TOOLCHAIN_BUILDROOT_CXX=y
BR2_TOOLCHAIN_GLIBC_GCONV_LIBS_COPY=y
BR2_TARGET_OPTIMIZATION="-Os -pipe"
BR2_TARGET_GENERIC_HOSTNAME="genie"
BR2_TARGET_GENERIC_ISSUE="Welcome to Genie"
BR2_INIT_SYSV=y
BR2_ROOTFS_DEVICE_CREATION_DYNAMIC_EUDEV=y
BR2_ROOTFS_DEVICE_TABLE="${BR2_EXTERNAL}/board/genie/device_table.txt"
BR2_TARGET_GENERIC_ROOT_PASSWD="genie"
BR2_SYSTEM_BIN_SH_BASH=y
BR2_SYSTEM_DHCP="eth0"
BR2_ENABLE_LOCALE_WHITELIST="en_US ru_RU ru_RU.UTF-8"
BR2_GENERATE_LOCALE="en_US ru_RU ru_RU.UTF-8"
BR2_TARGET_TZ_INFO=y
BR2_TARGET_LOCALTIME="Europe/Kiev"
BR2_ROOTFS_OVERLAY="${BR2_EXTERNAL}/board/genie/rootfs_overlay ${BR2_EXTERNAL}/board/genie/rootfs_overlay_priv"
BR2_ROOTFS_POST_BUILD_SCRIPT="${BR2_EXTERNAL}/board/genie/post-build.sh"
BR2_ROOTFS_POST_IMAGE_SCRIPT="${BR2_EXTERNAL}/board/genie/post-image.sh ${BR2_EXTERNAL}/board/genie/swupdate/build-swu.sh"
BR2_LINUX_KERNEL=y
BR2_LINUX_KERNEL_CUSTOM_TARBALL=y
BR2_LINUX_KERNEL_CUSTOM_TARBALL_LOCATION="$(call github,raspberrypi,linux,raspberrypi-kernel_1.20190819-1)/linux-raspberrypi-kernel_1.20190819-1.tar.gz"
BR2_LINUX_KERNEL_DEFCONFIG="bcmrpi"
BR2_LINUX_KERNEL_DTS_SUPPORT=y
BR2_LINUX_KERNEL_INTREE_DTS_NAME="bcm2708-rpi-zero-w"
BR2_LINUX_KERNEL_NEEDS_HOST_OPENSSL=y
BR2_PACKAGE_ALSA_UTILS=y
BR2_PACKAGE_ALSA_UTILS_ALSACONF=y
BR2_PACKAGE_ALSA_UTILS_ACONNECT=y
BR2_PACKAGE_ALSA_UTILS_AMIDI=y
BR2_PACKAGE_ALSA_UTILS_AMIXER=y
BR2_PACKAGE_ALSA_UTILS_APLAY=y
BR2_PACKAGE_ALSA_UTILS_APLAYMIDI=y
BR2_PACKAGE_ALSA_UTILS_ARECORDMIDI=y
BR2_PACKAGE_ALSA_UTILS_ASEQDUMP=y
BR2_PACKAGE_ALSA_UTILS_ASEQNET=y
BR2_PACKAGE_ALSA_UTILS_IECSET=y
BR2_PACKAGE_ALSA_UTILS_SPEAKER_TEST=y
BR2_PACKAGE_AUMIX=y
BR2_PACKAGE_ESPEAK=y
BR2_PACKAGE_ESPEAK_AUDIO_BACKEND_ALSA=y
BR2_PACKAGE_FFMPEG=y
BR2_PACKAGE_GZIP=y
BR2_PACKAGE_BINUTILS=y
BR2_PACKAGE_BINUTILS_TARGET=y
BR2_PACKAGE_GETTEXT=y
BR2_PACKAGE_MAKE=y
BR2_PACKAGE_SED=y
BR2_PACKAGE_E2FSPROGS=y
BR2_PACKAGE_E2FSPROGS_RESIZE2FS=y
BR2_PACKAGE_MTD=y
BR2_PACKAGE_OBSIDIAN_CURSORS=y
BR2_PACKAGE_BITSTREAM_VERA=y
BR2_PACKAGE_DEJAVU=y
BR2_PACKAGE_INCONSOLATA=y
BR2_PACKAGE_LIBERATION=y
BR2_PACKAGE_RPI_FIRMWARE=y
BR2_PACKAGE_RPI_FIRMWARE_X=y
BR2_PACKAGE_RPI_FIRMWARE_INSTALL_VCDBG=y
BR2_PACKAGE_RPI_WIFI_FIRMWARE=y
BR2_PACKAGE_I2C_TOOLS=y
BR2_PACKAGE_RNG_TOOLS=y
BR2_PACKAGE_USBUTILS=y
BR2_PACKAGE_LUA=y
BR2_PACKAGE_NODEJS=y
BR2_PACKAGE_NODEJS_NPM=y
BR2_PACKAGE_NODEJS_MODULES_ADDITIONAL="node-red node-red-contrib-wit"
BR2_PACKAGE_PYTHON3=y
BR2_PACKAGE_PYTHON3_PY_PYC=y
BR2_PACKAGE_PYTHON3_BZIP2=y
BR2_PACKAGE_PYTHON3_XZ=y
BR2_PACKAGE_PYTHON_PILLOW=y
BR2_PACKAGE_PYTHON_PIP=y
BR2_PACKAGE_PYTHON_RPI_GPIO=y
BR2_PACKAGE_PYTHON_SERIAL=y
BR2_PACKAGE_LIBAO=y
BR2_PACKAGE_LIBSAMPLERATE=y
BR2_PACKAGE_SQLITE=y
BR2_PACKAGE_SQLITE_NO_SYNC=y
BR2_PACKAGE_LIBCONFIG=y
BR2_PACKAGE_FONTCONFIG=y
BR2_PACKAGE_GIFLIB=y
BR2_PACKAGE_JPEG=y
BR2_PACKAGE_LIBPNG=y
BR2_PACKAGE_DTC=y
BR2_PACKAGE_WIRINGPI=y
BR2_PACKAGE_LIBCURL=y
BR2_PACKAGE_CURL=y
BR2_PACKAGE_LIBEVDEV=y
BR2_PACKAGE_MPC=y
BR2_PACKAGE_ICU=y
BR2_PACKAGE_PCRE2=y
BR2_PACKAGE_PCRE2_16=y
BR2_PACKAGE_BC=y
BR2_PACKAGE_IPERF3=y
BR2_PACKAGE_IPROUTE2=y
BR2_PACKAGE_IPTABLES=y
BR2_PACKAGE_IW=y
BR2_PACKAGE_MOSQUITTO=y
BR2_PACKAGE_NTP=y
BR2_PACKAGE_OPENSSH=y
BR2_PACKAGE_WPA_SUPPLICANT=y
BR2_PACKAGE_WPA_SUPPLICANT_AP_SUPPORT=y
BR2_PACKAGE_WPA_SUPPLICANT_WIFI_DISPLAY=y
BR2_PACKAGE_SCREEN=y
BR2_PACKAGE_PROCPS_NG=y
BR2_PACKAGE_SWUPDATE=y
BR2_PACKAGE_SWUPDATE_CONFIG="${BR2_EXTERNAL}/board/genie/swupdate/swupdate.config"
BR2_PACKAGE_MC=y
BR2_PACKAGE_NANO=y
BR2_PACKAGE_VIM=y
# BR2_PACKAGE_VIM_RUNTIME is not set
BR2_TARGET_ROOTFS_EXT2=y
BR2_TARGET_ROOTFS_EXT2_4=y
BR2_TARGET_ROOTFS_EXT2_SIZE="1000000"
BR2_TARGET_ROOTFS_EXT2_MKFS_OPTIONS="-O 64bit"
# BR2_TARGET_ROOTFS_TAR is not set
BR2_PACKAGE_HOST_DOSFSTOOLS=y
BR2_PACKAGE_HOST_GENIMAGE=y
BR2_PACKAGE_HOST_MTOOLS=y
BR2_PACKAGE_GENIE_ASSISTANT=y
BR2_PACKAGE_PICOTTS=y
BR2_PACKAGE_PYTHON_SPEECHRECOGNITION=y
BR2_PACKAGE_PYTHON_PYDUB=y
BR2_PACKAGE_PYTHON_PYOWM=y
BR2_PACKAGE_PYTHON_POCKETSPHINX=y
BR2_PACKAGE_WM8960=y
BR2_PACKAGE_SPEECH_DISPATCHER_ESPEAK=y
BR2_PACKAGE_SPEECH_DISPATCHER_RHVOICE=y
BR2_PACKAGE_RHVOICE=y
BR2_PACKAGE_ALSA_PLUGINS=y
```

## nvr/defconfig
```kconfig
BR2_arm=y
BR2_cortex_a7=y
BR2_ARM_FPU_NEON_VFPV4=y
BR2_DL_DIR="$(HOME)/.dl"
BR2_CCACHE=y
BR2_CCACHE_DIR="$(HOME)/.ccache"
BR2_TOOLCHAIN_BUILDROOT_GLIBC=y
BR2_KERNEL_HEADERS_4_14=y
BR2_TOOLCHAIN_BUILDROOT_CXX=y
BR2_TARGET_GENERIC_HOSTNAME="nvr"
BR2_TARGET_GENERIC_ISSUE="Welcome to NVR"
BR2_INIT_SYSV=y
BR2_ROOTFS_DEVICE_CREATION_DYNAMIC_EUDEV=y
BR2_ROOTFS_DEVICE_TABLE="${BR2_EXTERNAL}/board/iot/device_table.txt"
BR2_TARGET_GENERIC_ROOT_PASSWD="nvr"
BR2_SYSTEM_BIN_SH_BASH=y
BR2_SYSTEM_DHCP="eth0"
BR2_TARGET_TZ_INFO=y
BR2_TARGET_LOCALTIME="Europe/Kiev"
BR2_ROOTFS_OVERLAY="${BR2_EXTERNAL}/board/nvr/rootfs_overlay"
BR2_ROOTFS_POST_BUILD_SCRIPT="${BR2_EXTERNAL}/board/nvr/post-build.sh"
BR2_ROOTFS_POST_IMAGE_SCRIPT="${BR2_EXTERNAL}/board/nvr/post-image.sh ${BR2_EXTERNAL}/board/nvr/swupdate/build-swu.sh"
BR2_LINUX_KERNEL=y
BR2_LINUX_KERNEL_CUSTOM_GIT=y
BR2_LINUX_KERNEL_CUSTOM_REPO_URL="https://github.com/raspberrypi/linux.git"
BR2_LINUX_KERNEL_CUSTOM_REPO_VERSION="9b15abaf52801fae247a66f6efbf0819da72610d"
BR2_LINUX_KERNEL_DEFCONFIG="bcm2709"
BR2_LINUX_KERNEL_DTS_SUPPORT=y
BR2_LINUX_KERNEL_INTREE_DTS_NAME="bcm2709-rpi-2-b bcm2710-rpi-3-b bcm2710-rpi-3-b-plus bcm2710-rpi-cm3"
BR2_PACKAGE_FFMPEG=y
BR2_PACKAGE_FFMPEG_GPL=y
BR2_PACKAGE_FFMPEG_NONFREE=y
BR2_PACKAGE_MOTION=y
BR2_PACKAGE_BZIP2=y
BR2_PACKAGE_XZ=y
BR2_PACKAGE_E2FSPROGS_RESIZE2FS=y
BR2_PACKAGE_MTD=y
BR2_PACKAGE_RPI_FIRMWARE=y
BR2_PACKAGE_RPI_FIRMWARE_X=y
BR2_PACKAGE_RPI_FIRMWARE_INSTALL_VCDBG=y
BR2_PACKAGE_RPI_WIFI_FIRMWARE=y
BR2_PACKAGE_I2C_TOOLS=y
BR2_PACKAGE_PARTED=y
BR2_PACKAGE_PYTHON=y
BR2_PACKAGE_PYTHON_READLINE=y
BR2_PACKAGE_PYTHON_SQLITE=y
BR2_PACKAGE_PYTHON_HASHLIB=y
BR2_PACKAGE_PYTHON_JINJA2=y
BR2_PACKAGE_PYTHON_PIGPIO=y
BR2_PACKAGE_PYTHON_PILLOW=y
BR2_PACKAGE_PYTHON_PIP=y
BR2_PACKAGE_PYTHON_PYTZ=y
BR2_PACKAGE_PYTHON_SMBUS_CFFI=y
BR2_PACKAGE_PYTHON_VERSIONTOOLS=y
BR2_PACKAGE_CA_CERTIFICATES=y
BR2_PACKAGE_LIBSSH2=y
BR2_PACKAGE_LIBOPENSSL_BIN=y
BR2_PACKAGE_LIBOPENSSL_ENGINES=y
BR2_PACKAGE_LIBV4L=y
BR2_PACKAGE_LIBV4L_UTILS=y
BR2_PACKAGE_WIRINGPI=y
BR2_PACKAGE_LIBTHEORA=y
BR2_PACKAGE_X264=y
BR2_PACKAGE_X265=y
BR2_PACKAGE_LIBCURL=y
BR2_PACKAGE_LIBCAP=y
BR2_PACKAGE_LIBEVDEV=y
BR2_PACKAGE_AUTOSSH=y
BR2_PACKAGE_CHRONY=y
BR2_PACKAGE_CRDA=y
BR2_PACKAGE_IPERF3=y
BR2_PACKAGE_IPROUTE2=y
BR2_PACKAGE_IPTABLES=y
BR2_PACKAGE_IW=y
BR2_PACKAGE_NET_TOOLS=y
BR2_PACKAGE_NETCAT=y
BR2_PACKAGE_NTP=y
BR2_PACKAGE_NTP_SNTP=y
BR2_PACKAGE_OPENSSH=y
BR2_PACKAGE_PPPD=y
BR2_PACKAGE_PROFTPD=y
BR2_PACKAGE_RSYNC=y
BR2_PACKAGE_SAMBA4=y
BR2_PACKAGE_WIRELESS_TOOLS=y
BR2_PACKAGE_WPA_SUPPLICANT=y
BR2_PACKAGE_WPA_SUPPLICANT_AP_SUPPORT=y
BR2_PACKAGE_WPA_SUPPLICANT_WIFI_DISPLAY=y
BR2_PACKAGE_LOGROTATE=y
BR2_PACKAGE_PROCPS_NG=y
BR2_PACKAGE_SWUPDATE=y
BR2_PACKAGE_SWUPDATE_CONFIG="${BR2_EXTERNAL}/board/nvr/swupdate/swupdate.config"
BR2_PACKAGE_TAR=y
BR2_PACKAGE_UTIL_LINUX_BINARIES=y
BR2_PACKAGE_UTIL_LINUX_PARTX=y
BR2_PACKAGE_MC=y
BR2_PACKAGE_NANO=y
BR2_TARGET_ROOTFS_EXT2=y
BR2_TARGET_ROOTFS_EXT2_4=y
BR2_TARGET_ROOTFS_EXT2_SIZE="524288"
BR2_TARGET_ROOTFS_EXT2_MKFS_OPTIONS="-O 64bit"
# BR2_TARGET_ROOTFS_TAR is not set
BR2_PACKAGE_HOST_DOSFSTOOLS=y
BR2_PACKAGE_HOST_GENIMAGE=y
BR2_PACKAGE_HOST_MTOOLS=y
BR2_PACKAGE_HOST_PYTHON=y
# BR2_PACKAGE_POCKETSPHINX is not set
```

## package/433utils/Config.in
```kconfig
config BR2_PACKAGE_433UTILS
	bool "433Utils"
	depends on BR2_PACKAGE_WIRINGPI
	help
	  433Utils is a collection of code and documentation designed to assist you in the connection and usage of RF 433MHz transmit and receive modules to/with your Arduino and Rapberry Pi.

	  https://github.com/ninjablocks/433Utils
```

## package/alsa-plugins/Config.in
```kconfig
config BR2_PACKAGE_ALSA_PLUGINS
	bool "alsa-plugins"
	depends on BR2_arm
	depends on BR2_TOOLCHAIN_HAS_THREADS # alsa-lib
	select BR2_PACKAGE_ALSA_LIB
	help
	  The Advanced Linux Sound Architecture (ALSA) - plugins 
```

## package/analogclock/Config.in
```kconfig
config BR2_PACKAGE_ANALOGCLOCK
        bool "analogclock"
        depends on BR2_PACKAGE_QT5
        select BR2_PACKAGE_QT5BASE_WIDGETS
        help
          Qt5 widgets analogclock application.
```

## package/atlas/Config.in
```kconfig
config BR2_PACKAGE_ATLAS
   bool "atlas"
   select BR2_TOOLCHAIN_BUILDROOT_FORTRAN
   help
      Automatically Tuned Linear Algebra Software (ATLAS)
      
      http://math-atlas.sourceforge.net/

if BR2_PACKAGE_ATLAS

config BR2_PACKAGE_ATLAS_PREBUILD
	bool "Use prebuild binary libraries"
	default y

if !BR2_PACKAGE_ATLAS_PREBUILD

config BR2_PACKAGE_ATLAS_REMOTE_IP
	string "Remote test device IP address"
	default "192.168.10.178"

endif

endif
```

## package/dashboard/Config.in
```kconfig
config BR2_PACKAGE_DASHBOARD
        bool "dashboard"
        depends on BR2_PACKAGE_QT5
        select BR2_PACKAGE_QT5BASE_WIDGETS
        help
          Dashboard application.
```

## package/espeak-ng/Config.in
```kconfig
config BR2_PACKAGE_ESPEAK_NG
	bool "espeak-ng"
	depends on BR2_INSTALL_LIBSTDCPP
	depends on BR2_USE_WCHAR
	depends on BR2_TOOLCHAIN_HAS_THREADS
	depends on BR2_USE_MMU # fork()
	# does not properly support building only a static version
	depends on !BR2_STATIC_LIBS
	depends on !BR2_PACKAGE_ESPEAK
	help
	  eSpeak NG is an open source speech synthesizer that supports 109 languages and accents.

	  https://github.com/espeak-ng/espeak-ng
```

## package/genie_assistant/Config.in
```kconfig
config BR2_PACKAGE_GENIE_ASSISTANT
	bool "genie_assistant"
	depends on BR2_PACKAGE_PYTHON3
	select BR2_PACKAGE_SNOWBOY
	help
	  genie_assistant

	  https://github.com/nwlab/genie_assistant
```

## package/libdotconf/Config.in
```kconfig
config BR2_PACKAGE_LIBDOTCONF
	bool "libdotconf"
	help
	  dot.conf configuration file parser

	  http://github.com/williamh/dotconf
```

## package/picotts/Config.in
```kconfig
config BR2_PACKAGE_PICOTTS
   bool "picotts"
   select BR2_PACKAGE_POPT
   help
     PicoTTS: text-to-speech voice synthesizer from Android AOSP.
     It is lightweight and sounds quite good and natural.
     PicoTTS supports languages: English (British and American),
     Spanish, German, French and Italian.
```

## package/pocketsphinx/Config.in
```kconfig
config BR2_PACKAGE_POCKETSPHINX
	bool "pocketsphinx"
	default y
    select BR2_PACKAGE_SPHINXBASE
	help
	  pocketsphinx is apps.

if BR2_PACKAGE_POCKETSPHINX

config BR2_PACKAGE_POCKETSPHINX_RUS
    bool
	default y

endif
```

## package/python-PyAudio/Config.in
```kconfig
comment "python-PyAudio needs a toolchain w/ threads"
	depends on !BR2_TOOLCHAIN_HAS_THREADS

config BR2_PACKAGE_PYTHON_PYAUDIO
	bool "python-PyAudio"
	depends on BR2_TOOLCHAIN_HAS_THREADS # alsa-lib
	select BR2_PACKAGE_PORTAUDIO
	help
      PyAudio provides Python bindings for PortAudio v19, the cross-platform audio I/O library

	  http://people.csail.mit.edu/hubert/pyaudio/
```

## package/python-RHVoice/Config.in
```kconfig
config BR2_PACKAGE_PYTHON_RHVOICE
	bool "python-RHVoice"
	depends on BR2_PACKAGE_PYTHON3 # python-tempora
	help
	  Free and open source speech synthesizer

	  https://github.com/techtonik/RHVoice/tree/master/src/nvda-synthDriver
```
